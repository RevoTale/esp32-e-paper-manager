## firmware/esp32/main/Kconfig.projbuild
```kconfig
menu "E-paper receiver"
config EP_EXPERIMENTAL_PARTIAL
    bool "Enable experimental 7.5 V2 region refresh"
    default n
    help
        Candidate only. Requires physical qualification of wake, old/new
        controller RAM, ghosting and refresh timing on the exact panel.
        The accepted full-only receiver remains the default recovery build.
endmenu
```

## firmware/esp32/sdkconfig.defaults
```kconfig
CONFIG_IDF_TARGET="esp32"
CONFIG_ESPTOOLPY_FLASHSIZE_4MB=y
CONFIG_PARTITION_TABLE_CUSTOM=y
CONFIG_PARTITION_TABLE_CUSTOM_FILENAME="partitions.csv"
CONFIG_ESP_CONSOLE_NONE=y
CONFIG_LOG_DEFAULT_LEVEL_NONE=y
CONFIG_BOOTLOADER_LOG_LEVEL_NONE=y
CONFIG_ESP_SYSTEM_PANIC_SILENT_REBOOT=y
CONFIG_ESP_COREDUMP_ENABLE_TO_NONE=y
CONFIG_ESP_MAIN_TASK_STACK_SIZE=8192
CONFIG_ESP_TASK_WDT_EN=y
CONFIG_ESP_TASK_WDT_PANIC=y
CONFIG_ESP_WIFI_NVS_ENABLED=n
CONFIG_BT_ENABLED=n
```
